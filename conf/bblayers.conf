## conf/bblayers.conf
```bitbake
# POKY_BBLAYERS_CONF_VERSION is increased each time build/conf/bblayers.conf
# changes incompatibly
POKY_BBLAYERS_CONF_VERSION = "2"

BBPATH = "${TOPDIR}"
BBFILES ?= ""

BBLAYERS ?= " \
    ${HOME}/yocto/input/poky-zeus/meta \
    ${HOME}/yocto/input/poky-zeus/meta-poky \
    ${HOME}/yocto/input/poky-zeus/meta-openembedded/meta-oe \
    ${HOME}/yocto/input/poky-zeus/meta-openembedded/meta-multimedia \
    ${HOME}/yocto/input/poky-zeus/meta-openembedded/meta-networking \
    ${HOME}/yocto/input/poky-zeus/meta-openembedded/meta-perl \
    ${HOME}/yocto/input/poky-zeus/meta-openembedded/meta-python \
    ${HOME}/yocto/input/poky-zeus/meta-qt5 \
    ${HOME}/yocto/input/poky-zeus/meta-raspberrypi \
    ${HOME}/yocto/input/poky-zeus/meta-security \
    ${HOME}/yocto/input/poky-zeus/meta-jumpnow \
    ${HOME}/yocto/input/rpi/meta-rpi \
"
```
